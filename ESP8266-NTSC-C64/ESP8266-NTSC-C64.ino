#include <Arduino.h>
const int PS2DataPin = D3;
const int PS2IRQpin  = D2;
const int AudioPin = D1;
#include "wifi_credentials.h"

#define FREQUENCY    160   
#include "ESP8266WiFi.h"
#include <ESP8266WiFiMulti.h>
#include <ArduinoOTA.h>
#include <PS2Keyboard.h>

#define BUILTIN_PRGS
#ifdef BUILTIN_PRGS
#include "builtinprg_1.h"
#include "builtinprg_2.h"
#include "builtinprg_3.h"
#include "builtinprg_4.h"
#include "builtinprg_5.h"
#include "builtinprg_6.h"
#include "builtinprg_7.h"
#include "builtinprg_8.h"
#include "builtinprg_9.h"
#include "builtinprg_10.h"
#include "builtinprg_11.h"
#include "builtinprg_12.h"
#endif  /* BUILTIN_PRGS */

extern "C" {
#include "user_interface.h"
#include "cpu.h"
}

void beep(int frequency, int duration = 100) {
  analogWriteFreq(frequency);
  analogWrite(AudioPin, PWMRANGE / 2);
  delay(duration);
  analogWrite(AudioPin, 0);
}



void load_prg(const uint8_t *data, uint16_t len) {
  uint16_t ptr = 0;
  uint16_t addr = (uint16_t)pgm_read_byte(data + ptr++) + 0x100 * pgm_read_byte(data + ptr++);
  while (ptr < len) {
    write6502(addr + ptr - 2, pgm_read_byte(data + ptr));
    ++ptr;
  }
  // see mem_set_basic_text() at https://github.com/stuartcarnie/vice-emu/blob/238d23b8b7e4fe3b6077273d0c99b1d8c3fc0b8c/vice/src/autostart-prg.c
  uint16_t end = addr + ptr - 2;
  uint8_t lo = end & 0xff, hi = end >> 8;
  write6502(0x2d, lo); write6502(0x2f, lo); write6502(0x31, lo); write6502(0xae, lo);
  write6502(0x2e, hi); write6502(0x30, hi); write6502(0x32, hi); write6502(0xaf, hi);
  write6502(addr_keybuf+0,'R');
  write6502(addr_keybuf+1,'U');
  write6502(addr_keybuf+2,'N');
  write6502(addr_keybuf+3,13);
  write6502(addr_keybuf_len,4);
}


//CBM Textset1 ROM
unsigned char charROM [] = { 0x1C , 0x22 , 0x4A , 0x56 , 0x4C , 0x20 , 0x1E , 0x0 , 0x18 , 0x24 , 0x42 , 0x7E , 0x42 ,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 0xF0 , 0xF0 };

uint8_t screenmem[1000];
uint8_t colormem[1000];
uint8_t *RAM = NULL;
#define RAM_size 16384
uint8_t BOARDER;
uint8_t BGCOLOR;
uint8_t VIC_D020;
uint8_t VIC_D021;


extern "C" {
  void videoinit();
  void videostop();
  }


PS2Keyboard keyboard;

// see http://sta.c64.org/cbm64petkey.html and https://www.c64-wiki.com/wiki/Keyboard
#define C64_STOP           3
#define C64_RETURN        13
#define C64_DOWN          17
#define C64_HOME          19
#define C64_DELETE        20
#define C64_RIGHT         29
#define C64_RUN          131
#define C64_F1           133
#define C64_F3           134
#define C64_F5           135
#define C64_F7           136
#define C64_F2           137
#define C64_F4           138
#define C64_F6           139
#define C64_F8           140
#define C64_SHIFT_RETURN 141
#define C64_UP           145
#define C64_CLEAR        147
#define C64_INSERT       148
#define C64_LEFT         157

#define HOTKEY_P1        224
#define HOTKEY_P2        225
#define HOTKEY_P3        226
#define HOTKEY_P4        227
#define HOTKEY_P5        228
#define HOTKEY_P6        229
#define HOTKEY_P7        230
#define HOTKEY_P8        231
#define HOTKEY_P9        232
#define HOTKEY_P10       233
#define HOTKEY_P11       234
#define HOTKEY_P12       235

#define HOTKEY_F9        248
#define HOTKEY_F10       249
#define HOTKEY_F11       250
#define HOTKEY_F12       251
#define HOTKEY_SCROLL    252
#define HOTKEY_ESC       253
#define HOTKEY_SHIFT_ESC 254
#define HOTKEY_NUMLOCK   255

const PROGMEM PS2Keymap_t PS2Keymap_German_c64 = {
  // without shift
  {0, HOTKEY_F9, 0, C64_F5, C64_F3, C64_F1, C64_F2, HOTKEY_F12,
  0, HOTKEY_F10, C64_F8, C64_F6, C64_F4, C64_RUN /*PS2_TAB*/, '^', 0,
  0, 0 /*Lalt*/, 0 /*Lshift*/, 0, 0 /*Lctrl*/, 'Q', '1', 0,
  0, 0, 'Y', 'S', 'A', 'W', '2', 0,
  0, 'C', 'X', 'D', 'E', '4', '3', 0,
  0, ' ', 'V', 'F', 'T', 'R', '5', 0,
  0, 'N', 'B', 'H', 'G', 'Z', '6', 0,
  0, 0, 'M', 'J', 'U', '7', '8', 0,
  0, ',', 'K', 'I', 'O', '0', '9', 0,
  0, '.', '-', 'L', PS2_o_DIAERESIS, 'P', PS2_SHARP_S, 0,
  0, 0, PS2_a_DIAERESIS, 0, PS2_u_DIAERESIS, '\'', 0, 0,
  0 /*CapsLock*/, 0 /*Rshift*/, C64_RETURN /*PS2_ENTER*/ /*Enter*/, '+', 0, '#', 0, 0,
  0, '<', 0, 0, 0, 0, C64_DELETE /*PS2_BACKSPACE*/, 0,
  0, '1', 0, '4', '7', 0, 0, 0,
  '0', '.', '2', '5', '6', '8', HOTKEY_ESC, HOTKEY_NUMLOCK /*NumLock*/,
  HOTKEY_F11, '+', '3', '-', '*', '9', HOTKEY_SCROLL, 0,
  0, 0, 0, C64_F7 },
  // with shift
  {0, HOTKEY_P9, 0, HOTKEY_P5, HOTKEY_P3, HOTKEY_P1, HOTKEY_P2, HOTKEY_P12,
  0, HOTKEY_P10, HOTKEY_P8, HOTKEY_P6, HOTKEY_P4, C64_STOP /*PS2_TAB*/, PS2_DEGREE_SIGN, 0,
  0, 0 /*Lalt*/, 0 /*Lshift*/, 0, 0 /*Lctrl*/, 'q', '!', 0,
  0, 0, 'y', 's', 'a', 'w', '"', 0,
  0, 'c', 'x', 'd', 'e', '$', PS2_SECTION_SIGN, 0,
  0, ' ', 'v', 'f', 't', 'r', '%', 0,
  0, 'n', 'b', 'h', 'g', 'z', '&', 0,
  0, 0, 'm', 'j', 'u', '/', '(', 0,
  0, ';', 'k', 'i', 'o', '=', ')', 0,
  0, ':', '_', 'l', PS2_O_DIAERESIS, 'p', '?', 0,
  0, 0, PS2_A_DIAERESIS, 0, PS2_U_DIAERESIS, '`', 0, 0,
  0 /*CapsLock*/, 0 /*Rshift*/, C64_SHIFT_RETURN /*PS2_ENTER*/ /*Enter*/, '*', 0, '\'', 0, 0,
  0, '>', 0, 0, 0, 0, C64_DELETE /*PS2_BACKSPACE*/, 0,
  0, '1', 0, '4', '7', 0, 0, 0,
  '0', '.', '2', '5', '6', '8', HOTKEY_SHIFT_ESC, HOTKEY_NUMLOCK /*NumLock*/,
  HOTKEY_P11, '+', '3', '-', '*', '9', HOTKEY_SCROLL, 0,
  0, 0, 0, HOTKEY_P7 },
  0, // don't use altgr any more, because EPS crashes (not yet analyzed why)
  // with altgr
  {0, HOTKEY_F9, 0, C64_F5, C64_F3, C64_F1, C64_F2, HOTKEY_F12,
  0, HOTKEY_F10, C64_F8, C64_F6, C64_F4, C64_RUN /*PS2_TAB*/, 0, 0,
  0, 0 /*Lalt*/, 0 /*Lshift*/, 0, 0 /*Lctrl*/, '@', 0, 0,
  0, 0, 0, 0, 0, 0, PS2_SUPERSCRIPT_TWO, 0,
  0, 0, 0, 0, PS2_CURRENCY_SIGN, 0, PS2_SUPERSCRIPT_THREE, 0,
  0, 0, 0, 0, 0, 0, 0, 0,
  0, 0, 0, 0, 0, 0, 0, 0,
  0, 0, PS2_MICRO_SIGN, 0, 0, '{', '[', 0,
  0, 0, 0, 0, 0, '}', ']', 0,
  0, 0, 0, 0, 0, 0, '\\', 0,
  0, 0, 0, 0, 0, 0, 0, 0,
  0 /*CapsLock*/, 0 /*Rshift*/, C64_RETURN /*PS2_ENTER*/ /*Enter*/, '~', 0, '#', 0, 0,
  0, '|', 0, 0, 0, 0, C64_DELETE /*PS2_BACKSPACE*/, 0,
  0, '1', 0, '4', '7', 0, 0, 0,
  '0', '.', '2', '5', '6', '8', HOTKEY_ESC, HOTKEY_NUMLOCK /*NumLock*/,
  HOTKEY_F11, '+', '3', '-', '*', '9', HOTKEY_SCROLL, 0,
  0, 0, 0, C64_F7 }
};


bool ota_mode = false;
bool wifi_connected=false;

ESP8266WiFiMulti WiFiMulti;

void setup() {
  system_update_cpu_freq(FREQUENCY);
  beep(440,100);
  keyboard.begin(PS2DataPin, PS2IRQpin, PS2Keymap_German_c64);
  delay(1000);
  ota_mode = keyboard.available() && keyboard.readUnicode() == HOTKEY_ESC;
  Serial.begin(115200);
  Serial.println("\r\n\r\nDebug mode, ESP ID: " + String(ESP.getChipId(), HEX));
  if (ota_mode) {
    WiFi.mode(WIFI_STA);
    WiFiMulti.addAP(WIFI_SSID, WIFI_PSK);
    WiFi.hostname("ESP8266-" + String(ESP.getChipId(), HEX));
    ArduinoOTA.onStart([]() {
      ota_mode = true;
      if(RAM) free(RAM);
      Serial.println("OTA starting...");
      Serial.flush();
      Serial.end();
      });
    ArduinoOTA.begin();
    beep(880,1000);
  } else {
    WiFi.forceSleepBegin();             
    delay(1);
    RAM=(uint8_t*)malloc(RAM_size);
    videoinit();
    reset6502();
    beep(220,50);
  }
}

void loop() {
  if (ota_mode) {
    if (!wifi_connected && WiFiMulti.run() == WL_CONNECTED) {
      Serial.print("IP address: ");
      Serial.println(WiFi.localIP());
      wifi_connected = true;
      beep(880,100);
    }
    ArduinoOTA.handle();
    if (keyboard.available()) {
      char c = keyboard.readUnicode();
      Serial.println("Key: " + String(c, DEC));
      if ( c  == HOTKEY_SCROLL ) {
        ESP.restart();
      }
    }
    yield();
    return;
  }

  exec6502(100);

  if (keyboard.available()) {
    char c = keyboard.readUnicode();

    if (c == PS2_UPARROW) {
      c = C64_UP;
    } else if (c == PS2_DOWNARROW) {
      c = C64_DOWN;
    } else if (c == PS2_LEFTARROW) {
      c = C64_LEFT;
    } else if (c == PS2_RIGHTARROW) {
      c = C64_RIGHT;
    }
    
    if (c == HOTKEY_SCROLL) {
      videostop();
      ESP.restart();
    } else if (c == HOTKEY_ESC || c == C64_STOP) {
      //nmi6502();
      write6502(addr_STKEY,STKEY_stop);
      exec6502(1000);
      write6502(addr_STKEY,STKEY_none);
    } else if (c == HOTKEY_SHIFT_ESC) {
      reset6502();
#ifdef BUILTIN_PRGS
    } else if (c == HOTKEY_P1) {
      load_prg(builtinprg_1_prg,builtinprg_1_prg_len);
    } else if (c == HOTKEY_P2) {
      load_prg(builtinprg_2_prg,builtinprg_2_prg_len);
    } else if (c == HOTKEY_P3) {
      load_prg(builtinprg_3_prg,builtinprg_3_prg_len);
    } else if (c == HOTKEY_P4) {
      load_prg(builtinprg_4_prg,builtinprg_4_prg_len);
    } else if (c == HOTKEY_P5) {
      load_prg(builtinprg_5_prg,builtinprg_5_prg_len);
    } else if (c == HOTKEY_P6) {
      load_prg(builtinprg_6_prg,builtinprg_6_prg_len);
    } else if (c == HOTKEY_P7) {
      load_prg(builtinprg_7_prg,builtinprg_7_prg_len);
    } else if (c == HOTKEY_P8) {
      load_prg(builtinprg_8_prg,builtinprg_8_prg_len);
    } else if (c == HOTKEY_P9) {
      load_prg(builtinprg_9_prg,builtinprg_9_prg_len);
    } else if (c == HOTKEY_P10) {
      load_prg(builtinprg_10_prg,builtinprg_10_prg_len);
    } else if (c == HOTKEY_P11) {
      load_prg(builtinprg_11_prg,builtinprg_11_prg_len);
    } else if (c == HOTKEY_P12) {
      load_prg(builtinprg_12_prg,builtinprg_12_prg_len);
#endif  /* BUILTIN_PRGS */

    } else if (c == HOTKEY_F9) {
      write6502(addr_keybuf+0,'R');
      write6502(addr_keybuf+1,'U');
      write6502(addr_keybuf+2,'N');
      write6502(addr_keybuf+3,13);
      write6502(addr_keybuf_len,4);
    } else if (c == HOTKEY_F10) {
      write6502(addr_keybuf+0,'L');
      write6502(addr_keybuf+1,'I');
      write6502(addr_keybuf+2,'S');
      write6502(addr_keybuf+3,'T');
      write6502(addr_keybuf+4,13);
      write6502(addr_keybuf_len,4);

    } else {
      write6502(addr_keybuf_len,1);
      write6502(addr_keybuf,c);
    }
  }
}
